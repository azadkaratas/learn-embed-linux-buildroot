## access_point/Config.in
```kconfig
menu "Target packages"
    source "$BR2_EXTERNAL_ACCESS_POINT_PATH/package/webctl/Config.in"
endmenu

menu "Select the board"
    source "$BR2_EXTERNAL_ACCESS_POINT_PATH/board/raspberrypi0w/Config.in"
    source "$BR2_EXTERNAL_ACCESS_POINT_PATH/board/raspberrypi3-64/Config.in"
endmenu
```

## access_point/package/webctl/Config.in
```kconfig
config BR2_PACKAGE_WEBCTL
    bool "WebCtl Package"
		default y
    help
      WebCtl is a package that controls tasks coming from the web and manages web files.
```

## background_logger/Config.in
```kconfig
menu "Target packages"
    source "$BR2_EXTERNAL_BACKGROUND_LOGGER_PATH/package/periodiclogger/Config.in"
endmenu

menu "Select the board"
    source "$BR2_EXTERNAL_BACKGROUND_LOGGER_PATH/board/raspberrypi0w/Config.in"
    source "$BR2_EXTERNAL_BACKGROUND_LOGGER_PATH/board/raspberrypi3-64/Config.in"
endmenu
```

## background_logger/package/periodiclogger/Config.in
```kconfig
config BR2_PACKAGE_PERIODICLOGGER
        bool "periodiclogger"
		default y
        help
          Runs as background daemon. Periodically logs the counter.
```

## dbus_example/Config.in
```kconfig
menu "Target packages"
    source "$BR2_EXTERNAL_DBUS_EXAMPLE_PATH/package/dbusserver/Config.in"
    source "$BR2_EXTERNAL_DBUS_EXAMPLE_PATH/package/dbusclient/Config.in"
endmenu

menu "Select the board"
source "$BR2_EXTERNAL_DBUS_EXAMPLE_PATH/board/raspberrypi0w/Config.in"
source "$BR2_EXTERNAL_DBUS_EXAMPLE_PATH/board/raspberrypi3-64/Config.in"
endmenu
```

## dbus_example/board/raspberrypi3-64/Config.in
```kconfig
config BR2_TARGET_BOARD_RPI_3B
    bool "Customize Raspberry Pi 3B+"
    help
      Use this option to build a custom Raspberry Pi 3B+ image.
```

## dbus_example/package/dbusclient/Config.in
```kconfig
config BR2_PACKAGE_DBUSCLIENT
        bool "dbusclient"
		default y
        help
          Sends data to DBUS server. Should be run manually.
```

## dbus_example/package/dbusserver/Config.in
```kconfig
config BR2_PACKAGE_DBUSSERVER
        bool "dbusserver"
		default y
        help
          Runs as background daemon. Listens the DBUS.
```

## headless_wifi_eth_setup/Config.in
```kconfig
menu "Select the Raspberry Pi board for external headless WiFi and Ethernet setup"

source "$BR2_EXTERNAL_HEADLESS_WIFI_ETH_SETUP_PATH/board/raspberrypi3-64/Config.in"

endmenu
```

## headless_wifi_setup/Config.in
```kconfig
menu "Select the Raspberry Pi board for external headless WiFi setup"

source "$BR2_EXTERNAL_HEADLESS_WIFI_SETUP_PATH/board/raspberrypi0w/Config.in"
source "$BR2_EXTERNAL_HEADLESS_WIFI_SETUP_PATH/board/raspberrypi3-64/Config.in"

endmenu
```

## nginx_nodejs/Config.in
```kconfig
menu "Select the board"
source "$BR2_EXTERNAL_NGINX_NODEJS_PATH/board/raspberrypi0w/Config.in"
endmenu
```

## nginx_nodejs/configs/custom_raspberrypi3b_64_defconfig
```kconfig
BR2_aarch64=y
BR2_ARM_FPU_VFPV4=y
BR2_PACKAGE_HOST_LINUX_HEADERS_CUSTOM_6_6=y
BR2_TOOLCHAIN_BUILDROOT_CXX=y
BR2_GLOBAL_PATCH_DIR="board/raspberrypi/patches"
BR2_DOWNLOAD_FORCE_CHECK_HASHES=y
BR2_TARGET_GENERIC_ROOT_PASSWD="root"
BR2_ROOTFS_POST_BUILD_SCRIPT="board/raspberrypi3-64/post-build.sh"
BR2_ROOTFS_POST_IMAGE_SCRIPT="board/raspberrypi3-64/post-image.sh"
BR2_LINUX_KERNEL=y
BR2_LINUX_KERNEL_CUSTOM_TARBALL=y
BR2_LINUX_KERNEL_CUSTOM_TARBALL_LOCATION="$(call github,raspberrypi,linux,576cc10e1ed50a9eacffc7a05c796051d7343ea4)/linux-576cc10e1ed50a9eacffc7a05c796051d7343ea4.tar.gz"
BR2_LINUX_KERNEL_DEFCONFIG="bcmrpi3"
BR2_LINUX_KERNEL_DTS_SUPPORT=y
BR2_LINUX_KERNEL_INTREE_DTS_NAME="broadcom/bcm2710-rpi-3-b broadcom/bcm2710-rpi-3-b-plus broadcom/bcm2710-rpi-cm3"
BR2_LINUX_KERNEL_NEEDS_HOST_OPENSSL=y
BR2_PACKAGE_BUSYBOX_SHOW_OTHERS=y
BR2_PACKAGE_XZ=y
BR2_PACKAGE_BRCMFMAC_SDIO_FIRMWARE_RPI=y
BR2_PACKAGE_BRCMFMAC_SDIO_FIRMWARE_RPI_WIFI=y
BR2_PACKAGE_RPI_FIRMWARE=y
BR2_PACKAGE_RPI_FIRMWARE_BOOTCODE_BIN=y
BR2_PACKAGE_RPI_FIRMWARE_VARIANT_PI=y
BR2_PACKAGE_RPI_FIRMWARE_CONFIG_FILE="board/raspberrypi3-64/config_3_64bit.txt"
BR2_PACKAGE_NODEJS=y
BR2_PACKAGE_NODEJS_NPM=y
BR2_PACKAGE_NODEJS_MODULES_ADDITIONAL="express body-parser fs path"
BR2_PACKAGE_NGINX=y
BR2_PACKAGE_OPENSSH=y
BR2_PACKAGE_WPA_SUPPLICANT=y
BR2_PACKAGE_WPA_SUPPLICANT_AUTOSCAN=y
BR2_PACKAGE_WPA_SUPPLICANT_PASSPHRASE=y
BR2_PACKAGE_KMOD=y
BR2_PACKAGE_KMOD_TOOLS=y
BR2_TARGET_ROOTFS_EXT2=y
BR2_TARGET_ROOTFS_EXT2_4=y
BR2_TARGET_ROOTFS_EXT2_SIZE="120M"
# BR2_TARGET_ROOTFS_TAR is not set
BR2_PACKAGE_HOST_DOSFSTOOLS=y
BR2_PACKAGE_HOST_GENIMAGE=y
BR2_PACKAGE_HOST_KMOD_XZ=y
BR2_PACKAGE_HOST_MTOOLS=y
BR2_TARGET_BOARD_RPI_3B=y
```

## nodejs_dbus/Config.in
```kconfig
menu "Target packages"
    source "$BR2_EXTERNAL_NODEJS_DBUS_PATH/package/webctl/Config.in"
    source "$BR2_EXTERNAL_NODEJS_DBUS_PATH/package/messenger/Config.in"
endmenu

menu "Select the board"
    source "$BR2_EXTERNAL_NODEJS_DBUS_PATH/board/raspberrypi0w/Config.in"
endmenu
```

## nodejs_dbus/package/messenger/Config.in
```kconfig
config BR2_PACKAGE_MESSENGER
    bool "messenger"
		default y
    help
      Runs as background daemon. Listens the DBUS and parses the messages.
```

## webserver_nginx/Config.in
```kconfig
menu "Select the board"
source "$BR2_EXTERNAL_WEBSERVER_NGINX_PATH/board/raspberrypi0w/Config.in"
source "$BR2_EXTERNAL_WEBSERVER_NGINX_PATH/board/raspberrypi3-64/Config.in"
endmenu
```

## webserver_nginx/board/raspberrypi0w/Config.in
```kconfig
config BR2_TARGET_BOARD_RPI_ZERO
    bool "Customize Raspberry Pi Zero"
    help
      Use this option to build a custom Raspberry Pi Zero image.
```
